## sdkconfig.defaults
```kconfig
# ESP-IDF default config for e-paper-monitor (overrides applied at first build)

# --- Flash (ESP32-WROOM-32 = 4MB) ---
CONFIG_ESPTOOLPY_FLASHSIZE_4MB=y
CONFIG_ESPTOOLPY_FLASHSIZE="4MB"

# --- Logging ---
CONFIG_LOG_DEFAULT_LEVEL_INFO=y
CONFIG_LOG_MAXIMUM_LEVEL_DEBUG=y

# --- FreeRTOS ---
CONFIG_FREERTOS_HZ=1000

# --- HTTP server ---
CONFIG_HTTPD_MAX_REQ_HDR_LEN=1024
CONFIG_HTTPD_MAX_URI_LEN=512

# --- esp_http_client (allow plain HTTP to the Scrutiny LAN host) ---
CONFIG_ESP_TLS_INSECURE=y
CONFIG_ESP_TLS_SKIP_SERVER_CERT_VERIFY=y

# --- Main task stack (app_main) ---
CONFIG_ESP_MAIN_TASK_STACK_SIZE=6144

# --- Compiler: enable C++ exceptions off to save flash (we avoid throwing) ---
CONFIG_COMPILER_CXX_EXCEPTIONS=n
CONFIG_COMPILER_OPTIMIZATION_SIZE=y
```
